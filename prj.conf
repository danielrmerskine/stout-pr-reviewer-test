## CMakeLists.txt
```
cmake_minimum_required(VERSION 3.20.0)
find_package(Zephyr REQUIRED HINTS $ENV{ZEPHYR_BASE})
project(stout_pr_reviewer_test LANGUAGES C)
target_sources(app PRIVATE src/main.c)
```

## west.yml
```
manifest:
  remotes:
    - name: nrfconnect
      url-base: https://github.com/nrfconnect
  projects:
    - name: nrf
      remote: nrfconnect
      revision: v2.7.0
      import: true
  self:
    path: app
```

## prj.conf
```kconfig
CONFIG_PRINTK=y
CONFIG_LOG=y
CONFIG_USE_SEGGER_RTT=y
CONFIG_LOG_BACKEND_RTT=y
CONFIG_LOG_MODE_IMMEDIATE=y
```

## src/main.c
```c
#include <zephyr/kernel.h>
#include <zephyr/sys/printk.h>

#define BLINK_PERIOD_MS 1000
#define MESSAGE         "blink"

int main(void)
{
	int counter = 0;
	while (1) {
		printk("%s %d\n", MESSAGE, counter++);
		k_msleep(BLINK_PERIOD_MS);
	}
	return 0;
}
```
